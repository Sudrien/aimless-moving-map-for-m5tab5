/*
 * launcherkey.c -- see launcherkey.h.
 *
 * The AES tables and aes_expand(), aes_inv_shiftrows(), aes_dec_block()
 * and aes128_cbc_decrypt() are defeatist's launcher_import.c at 74535ca,
 * byte for byte. The rest is its li_* functions under this file's names,
 * with the scan's run kept across calls (see launcherkey.h).
 *
 * SPDX-License-Identifier: MIT
 */
#include "launcherkey.h"

#include <string.h>

/* src: defeatist launcher_import.c LI_IV. */
static const uint8_t LI_IV[16] = {
    0x4C,0x61,0x75,0x6E,0x63,0x68,0x65,0x72,  /* "Launcher" */
    0x57,0x69,0x66,0x69,0x4B,0x65,0x79,0x21   /* "WifiKey!"  */
};

/* ---- vendored AES-128 (decrypt only) ------------------------------------ */
static const uint8_t AES_SB[256] = {
0x63,0x7c,0x77,0x7b,0xf2,0x6b,0x6f,0xc5,0x30,0x01,0x67,0x2b,0xfe,0xd7,0xab,0x76,
0xca,0x82,0xc9,0x7d,0xfa,0x59,0x47,0xf0,0xad,0xd4,0xa2,0xaf,0x9c,0xa4,0x72,0xc0,
0xb7,0xfd,0x93,0x26,0x36,0x3f,0xf7,0xcc,0x34,0xa5,0xe5,0xf1,0x71,0xd8,0x31,0x15,
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0x8c,0xa1,0x89,0x0d,0xbf,0xe6,0x42,0x68,0x41,0x99,0x2d,0x0f,0xb0,0x54,0xbb,0x16};
static const uint8_t AES_RCON[11] = {
    0x00,0x01,0x02,0x04,0x08,0x10,0x20,0x40,0x80,0x1b,0x36};

/*
 * InvMixColumns multiply tables (x9, x11, x13, x14 in GF(2^8)) and the
 * inverse S-box, precomputed. The earlier bytewise GF multiply in the
 * hot loop made a full-partition scan take ~16 s on core 0 and tripped
 * the task watchdog on starved IDLE0; table lookups plus the periodic
 * yield in li_scan_part() keep both in check. ~1.25 KB of flash.
 */
static const uint8_t AES_ISB[256] = {
    0x52,0x09,0x6a,0xd5,0x30,0x36,0xa5,0x38,0xbf,0x40,0xa3,0x9e,0x81,0xf3,0xd7,0xfb,
    0x7c,0xe3,0x39,0x82,0x9b,0x2f,0xff,0x87,0x34,0x8e,0x43,0x44,0xc4,0xde,0xe9,0xcb,
    0x54,0x7b,0x94,0x32,0xa6,0xc2,0x23,0x3d,0xee,0x4c,0x95,0x0b,0x42,0xfa,0xc3,0x4e,
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    0x17,0x2b,0x04,0x7e,0xba,0x77,0xd6,0x26,0xe1,0x69,0x14,0x63,0x55,0x21,0x0c,0x7d,
};
static const uint8_t AES_M9[256] = {
    0x00,0x09,0x12,0x1b,0x24,0x2d,0x36,0x3f,0x48,0x41,0x5a,0x53,0x6c,0x65,0x7e,0x77,
    0x90,0x99,0x82,0x8b,0xb4,0xbd,0xa6,0xaf,0xd8,0xd1,0xca,0xc3,0xfc,0xf5,0xee,0xe7,
    0x3b,0x32,0x29,0x20,0x1f,0x16,0x0d,0x04,0x73,0x7a,0x61,0x68,0x57,0x5e,0x45,0x4c,
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    0x31,0x38,0x23,0x2a,0x15,0x1c,0x07,0x0e,0x79,0x70,0x6b,0x62,0x5d,0x54,0x4f,0x46,
};
static const uint8_t AES_M11[256] = {
    0x00,0x0b,0x16,0x1d,0x2c,0x27,0x3a,0x31,0x58,0x53,0x4e,0x45,0x74,0x7f,0x62,0x69,
    0xb0,0xbb,0xa6,0xad,0x9c,0x97,0x8a,0x81,0xe8,0xe3,0xfe,0xf5,0xc4,0xcf,0xd2,0xd9,
    0x7b,0x70,0x6d,0x66,0x57,0x5c,0x41,0x4a,0x23,0x28,0x35,0x3e,0x0f,0x04,0x19,0x12,
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    0xca,0xc1,0xdc,0xd7,0xe6,0xed,0xf0,0xfb,0x92,0x99,0x84,0x8f,0xbe,0xb5,0xa8,0xa3,
};
static const uint8_t AES_M13[256] = {
    0x00,0x0d,0x1a,0x17,0x34,0x39,0x2e,0x23,0x68,0x65,0x72,0x7f,0x5c,0x51,0x46,0x4b,
    0xd0,0xdd,0xca,0xc7,0xe4,0xe9,0xfe,0xf3,0xb8,0xb5,0xa2,0xaf,0x8c,0x81,0x96,0x9b,
    0xbb,0xb6,0xa1,0xac,0x8f,0x82,0x95,0x98,0xd3,0xde,0xc9,0xc4,0xe7,0xea,0xfd,0xf0,
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    0xdc,0xd1,0xc6,0xcb,0xe8,0xe5,0xf2,0xff,0xb4,0xb9,0xae,0xa3,0x80,0x8d,0x9a,0x97,
};
static const uint8_t AES_M14[256] = {
    0x00,0x0e,0x1c,0x12,0x38,0x36,0x24,0x2a,0x70,0x7e,0x6c,0x62,0x48,0x46,0x54,0x5a,
    0xe0,0xee,0xfc,0xf2,0xd8,0xd6,0xc4,0xca,0x90,0x9e,0x8c,0x82,0xa8,0xa6,0xb4,0xba,
    0xdb,0xd5,0xc7,0xc9,0xe3,0xed,0xff,0xf1,0xab,0xa5,0xb7,0xb9,0x93,0x9d,0x8f,0x81,
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    0xd7,0xd9,0xcb,0xc5,0xef,0xe1,0xf3,0xfd,0xa7,0xa9,0xbb,0xb5,0x9f,0x91,0x83,0x8d,
};

static void aes_expand(const uint8_t k[16], uint8_t rk[176]) {
    memcpy(rk, k, 16);
    for (int i = 16; i < 176; i += 4) {
        uint8_t t[4] = { rk[i-4], rk[i-3], rk[i-2], rk[i-1] };
        if (i % 16 == 0) {
            uint8_t tmp = t[0];
            t[0] = AES_SB[t[1]] ^ AES_RCON[i/16];
            t[1] = AES_SB[t[2]]; t[2] = AES_SB[t[3]]; t[3] = AES_SB[tmp];
        }
        for (int j = 0; j < 4; j++) rk[i+j] = rk[i-16+j] ^ t[j];
    }
}
static void aes_inv_shiftrows(uint8_t s[16]) {
    uint8_t t;
    t = s[13]; s[13]=s[9]; s[9]=s[5]; s[5]=s[1]; s[1]=t;
    t = s[2]; s[2]=s[10]; s[10]=t; t=s[6]; s[6]=s[14]; s[14]=t;
    t = s[3]; s[3]=s[7]; s[7]=s[11]; s[11]=s[15]; s[15]=t;
}
static void aes_dec_block(const uint8_t rk[176], const uint8_t in[16], uint8_t out[16]) {
    uint8_t s[16]; memcpy(s, in, 16);
    for (int j = 0; j < 16; j++) s[j] ^= rk[160+j];
    for (int round = 9; round >= 1; round--) {
        aes_inv_shiftrows(s);
        for (int j = 0; j < 16; j++) s[j] = AES_ISB[s[j]];
        for (int j = 0; j < 16; j++) s[j] ^= rk[round*16+j];
        for (int c = 0; c < 4; c++) {                 /* InvMixColumns via tables */
            uint8_t *q = s + c*4, a0=q[0], a1=q[1], a2=q[2], a3=q[3];
            q[0] = AES_M14[a0]^AES_M11[a1]^AES_M13[a2]^AES_M9[a3];
            q[1] = AES_M9[a0]^AES_M14[a1]^AES_M11[a2]^AES_M13[a3];
            q[2] = AES_M13[a0]^AES_M9[a1]^AES_M14[a2]^AES_M11[a3];
            q[3] = AES_M11[a0]^AES_M13[a1]^AES_M9[a2]^AES_M14[a3];
        }
    }
    aes_inv_shiftrows(s);
    for (int j = 0; j < 16; j++) s[j] = AES_ISB[s[j]];
    for (int j = 0; j < 16; j++) s[j] ^= rk[j];
    memcpy(out, s, 16);
}
/* AES-128-CBC decrypt in place of mbedtls_aes_crypt_cbc. */
static void aes128_cbc_decrypt(const uint8_t key[16], const uint8_t iv[16],
                               const uint8_t *in, size_t n, uint8_t *out) {
    uint8_t rk[176]; aes_expand(key, rk);
    uint8_t prev[16]; memcpy(prev, iv, 16);
    for (size_t off = 0; off < n; off += 16) {
        uint8_t blk[16]; aes_dec_block(rk, in + off, blk);
        for (int j = 0; j < 16; j++) out[off+j] = blk[j] ^ prev[j];
        memcpy(prev, in + off, 16);
    }
}
/* ---- base64 ------------------------------------------------------------- */

int lkey_b64_decode(const char *s, uint8_t *o, size_t cap)
{
    int8_t t[256];
    memset(t, -1, sizeof(t));
    static const char A[] = "ABCDEFGHIJKLMNOPQRSTUVWXYZabcdefghijklmnopqrstuvwxyz0123456789+/";
    for (int i = 0; i < 64; i++) t[(uint8_t)A[i]] = (int8_t)i;
    size_t n = 0;
    int acc = 0, bits = 0;
    for (const char *p = s; *p && *p != '='; p++) {
        const int v = t[(uint8_t)*p];
        if (v < 0) continue;                 /* whitespace, newlines */
        acc = ((acc << 6) | v) & 0xFFFFFF;
        bits += 6;
        if (bits >= 8) {
            bits -= 8;
            if (n >= cap) return -1;
            o[n++] = (uint8_t)((acc >> bits) & 0xff);
        }
    }
    return (int)n;
}

/* ---- the key ------------------------------------------------------------ */

void lkey_build_key(const uint8_t *raw, size_t len, uint8_t key[16])
{
    if (len == 0) { memset(key, 0, 16); return; }
    for (int i = 0; i < 16; i++) key[i] = raw[i % len];
}

int lkey_decrypt(const uint8_t key[16], const uint8_t *ct, size_t ct_len,
                 uint8_t *out, size_t out_cap)
{
    if (ct_len == 0 || ct_len % 16 || ct_len + 1 > out_cap) return -1;
    aes128_cbc_decrypt(key, LI_IV, ct, ct_len, out);
    const int pad = out[ct_len - 1];
    if (pad < 1 || pad > 16 || (size_t)pad > ct_len) return -1;
    for (int i = 0; i < pad; i++) if (out[ct_len - 1 - i] != pad) return -1;
    const int plen = (int)ct_len - pad;
    if (plen < 1) return -1;
    for (int i = 0; i < plen; i++) if (out[i] < 0x20 || out[i] > 0x7e) return -1;
    out[plen] = 0;
    return plen;
}

bool lkey_oracle_add(lkey_oracle_t *o, const char *b64)
{
    if (o->n >= 2 || !b64 || !b64[0]) return false;
    const int n = lkey_b64_decode(b64, o->ct[o->n], sizeof(o->ct[0]));
    if (n <= 0 || n % 16) return false;
    o->len[o->n] = (size_t)n;
    o->n++;
    return true;
}

bool lkey_key_ok(const uint8_t key[16], const lkey_oracle_t *o)
{
    uint8_t tmp[LKEY_CT_MAX + 1];
    if (o->n < 1) return false;
    const int l0 = lkey_decrypt(key, o->ct[0], o->len[0], tmp, sizeof(tmp));
    if (l0 < 0) return false;
    if (o->n >= 2) return lkey_decrypt(key, o->ct[1], o->len[1], tmp, sizeof(tmp)) >= 0;
    return l0 >= 8;   /* one ciphertext: lean on WPA's 8-character floor */
}

/* ---- the scan ----------------------------------------------------------- */

void lkey_scan_init(lkey_scan_t *s, const lkey_oracle_t *o)
{
    memset(s, 0, sizeof(*s));
    s->o = o;
}

/* Every suffix of the run at least LKEY_MIN_CAND long, longest first. */
static void flush(lkey_scan_t *s)
{
    if (s->rl >= LKEY_MIN_CAND) {
        for (size_t k = 0; k + LKEY_MIN_CAND <= s->rl && !s->found; k++) {
            uint8_t key[16];
            lkey_build_key(s->run + k, s->rl - k, key);
            if (lkey_key_ok(key, s->o)) {
                memcpy(s->key, key, 16);
                s->found = true;
            }
        }
    }
    s->rl = 0;
}

bool lkey_scan(lkey_scan_t *s, const uint8_t *buf, size_t n)
{
    for (size_t i = 0; i < n && !s->found; i++) {
        const uint8_t b = buf[i];
        const bool pr = (b >= 0x20 && b <= 0x7e);
        if (pr && s->rl < LKEY_MAX_CAND) {
            s->run[s->rl++] = b;
            continue;
        }
        flush(s);
        if (pr) s->run[s->rl++] = b;
    }
    return s->found;
}

bool lkey_scan_end(lkey_scan_t *s)
{
    if (!s->found) flush(s);
    return s->found;
}

/* ---- what a value is ---------------------------------------------------- */

bool lkey_classify(const char *s, bool *is_psk)
{
    const size_t n = strlen(s);
    *is_psk = false;
    if (n == 64) {
        for (size_t i = 0; i < 64; i++) {
            const char c = s[i];
            const bool hex = (c >= '0' && c <= '9') || (c >= 'a' && c <= 'f') ||
                             (c >= 'A' && c <= 'F');
            if (!hex) return false;
        }
        *is_psk = true;
        return true;
    }
    return n >= 8 && n <= 63;
}
